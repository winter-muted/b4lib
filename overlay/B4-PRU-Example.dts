/dts-v1/;

/ {
	compatible = "ti,beaglebone", "ti,beaglebone-black";
	part-number = "B3-PRU-Example";
	version = "00A0";
	exclusive-use = "P9.27", "P9.28", "pru0";

	fragment@0 {
		target = <0xdeadbeef>;

		__overlay__ {

			pinmux_pru_pru_pins {
				pinctrl-single,pins = <0x1a4 0x15 0x194 0x15>;
				linux,phandle = <0x1>;
				phandle = <0x1>;
			};
		};
	};

	fragment@1 {
		target = <0xdeadbeef>;

		__overlay__ {
			status = "okay";
			pinctrl-names = "default";
			pinctrl-0 = <0x1>;
		};
	};

	__symbols__ {
		pru_pru_pins = "/fragment@0/__overlay__/pinmux_pru_pru_pins";
	};

	__local_fixups__ {

		fragment@1 {

			__overlay__ {
				pinctrl-0 = <0x0>;
			};
		};
	};

	__fixups__ {
		am33xx_pinmux = "/fragment@0:target:0";
		pruss = "/fragment@1:target:0";
	};
};
